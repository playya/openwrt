/* This file is released into the public domain */

/dts-v1/;

#include <dt-bindings/gpio/gpio.h>
#include <dt-bindings/input/input.h>

#include "mt7620a_netgear_ex3700_ex6130.dtsi"

/ {
	compatible = "netgear,ex6130", "ralink,mt7620a-soc";
	model = "Netgear EX6130";
};

